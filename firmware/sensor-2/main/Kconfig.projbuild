## firmware/sensor-2/main/Kconfig.projbuild
```kconfig
menu "Sensor report"

    config REPORT_DEST_ADDR
        string "CoAP destination (Pi mesh-local EID)"
        default "fd00::1"

endmenu
```

## firmware/sensor/main/Kconfig.projbuild
```kconfig
menu "Sensor report"
config REPORT_DEST_ADDR
    string "CoAP destination (Pi mesh-local EID)"
    default "fd00::1"
config REPORT_PERIOD_S
    int "Report period (s)"
    default 300
endmenu
```
